## meta-inventec/meta-transformers-nuv/conf/distro/buv-dev.conf
```bitbake
require conf/distro/openbmc-phosphor.conf

DISTRO = "buv-dev"
DISTRO_NAME = "Nuvoton OpenBMC (Dev Version)"
DISTRO_FEATURES:append = " buv-dev"
DISTROOVERRIDES .= ":buv-dev"
```

## meta-inventec/meta-transformers-nuv/conf/layer.conf
```bitbake
# We have a conf and classes directory, add to BBPATH
BBPATH .= ":${LAYERDIR}"

# We have recipes-* directories, add to BBFILES
BBFILES += "${LAYERDIR}/recipes-*/*/*.bb \
            ${LAYERDIR}/recipes-*/*/*.bbappend"

BBFILE_COLLECTIONS += "transformers-nuv"
BBFILE_PATTERN_transformers-nuv = "^${LAYERDIR}/"
BBFILE_PRIORITY_transformers-nuv = "7"
LAYERSERIES_COMPAT_transformers-nuv = "honister kirkstone"
```

## meta-inventec/meta-transformers-nuv/conf/machine/transformers-nuv.conf
```bitbake
require conf/machine/include/npcm7xx.inc
require conf/machine/include/obmc-bsp-common.inc
require conf/machine/include/inventec.inc

KMACHINE = "nuvoton"
KERNEL_DEVICETREE = "${KMACHINE}-npcm750-buv-runbmc.dtb"

FLASH_SIZE = "65536"
FLASH_UBOOT_OFFSET:flash-65536 = "0"
FLASH_KERNEL_OFFSET:flash-65536 = "2048"
FLASH_ROFS_OFFSET:flash-65536 = "8192"
FLASH_RWFS_OFFSET:flash-65536 = "62464"

UBOOT_MACHINE = "PolegRunBMC_defconfig"
UBOOT_DEVICETREE = "nuvoton-npcm750-buv"
IGPS_MACHINE = "RunBMC"

IMAGE_FSTYPES += " cpio.${INITRAMFS_CTYPE}.u-boot"
KERNEL_ALT_IMAGETYPE = "vmlinux"


MACHINE_FEATURES += "ext2"

DISTRO_FEATURES:remove = "avahi"
DISTRO_FEATURES:remove = "slp"

IMAGE_FEATURES:remove = "obmc-fan-control"


# If set to boolean true ('yes', 'y', 'true', 't', '1'), /var/log links to /var/volatile/log.
# If set to boolean false ('no', 'n', 'false', 'f', '0'), /var/log is on persistent storage.
VOLATILE_LOG_DIR = "false"
```

## meta-inventec/meta-transformers/conf/machine/transformers.conf
```bitbake
KMACHINE = "aspeed"
KERNEL_DEVICETREE = "${KMACHINE}-bmc-inventec-${MACHINE}.dtb"

require conf/machine/include/ast2600.inc
require conf/machine/include/obmc-bsp-common.inc
require conf/machine/include/inventec.inc

UBOOT_DEVICETREE = "ast2600-transformers"
UBOOT_MACHINE = "ast2600_openbmc_spl_defconfig"
SPL_BINARY = "spl/u-boot-spl.bin"
SOCSEC_SIGN_ENABLE = "0"

# To build a 64MB image, set FLASH_SIZE value to "65536".
FLASH_SIZE = "65536"
# Overwrite flash offsets
FLASH_UBOOT_SPL_SIZE ?= "64"
FLASH_UBOOT_OFFSET:flash-65536 = "0"
FLASH_UBOOT_ENV_OFFSET:flash-65536 ?= "896"
FLASH_KERNEL_OFFSET:flash-65536 = "1024"
FLASH_ROFS_OFFSET:flash-65536 = "10240"
FLASH_RWFS_OFFSET:flash-65536 = "43008"

# If set to boolean true ('yes', 'y', 'true', 't', '1'), /var/log links to /var/volatile/log.
# If set to boolean false ('no', 'n', 'false', 'f', '0'), /var/log is on persistent storage.
VOLATILE_LOG_DIR = "false"
```

## meta-nuvoton/conf/machine/include/keys.inc
```bitbake
# There are two valid types: "openssl" or "HSM".
# Currently, default support openssl only.
SIGN_TYPE ?= "openssl"

KEY_BB_INDEX ?= "1"
KEY_BL31_INDEX ?= "1"
KEY_OPTEE_INDEX ?= "1"
KEY_UBOOT_INDEX ?= "1"

KEY_BB_ID ?= "11"
KEY_BL31_ID ?= "11"
KEY_OPTEE_ID ?= "11"
KEY_UBOOT_ID ?= "11"

KEY_FOLDER ?= ""
KEY_FOLDER_DEFAULT ?= "${DEPLOY_DIR_IMAGE}/${SIGN_TYPE}"
KEY_BB ?= "skmt_ecc_key_1.der"
KEY_BL31 ?= "skmt_ecc_key_1.der"
KEY_OPTEE ?= "skmt_ecc_key_1.der"
KEY_UBOOT ?= "skmt_ecc_key_1.der"
```
